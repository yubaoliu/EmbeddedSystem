/****************************************Copyright (c)****************************************************
**                               SHANDOND TAIAN LIUYUBAO
**--------------File Info---------------------------------------------------------------------------------
** File Name:               LCD12864.c
** Last modified Date:      2010/08/15
** Description:             LCD TG12864E-02B(st7920驱动芯片)在LM3S1138上串行通信的驱动程序
**--------------------------------------------------------------------------------------------------------
** Created By:              LIUYUBAO
** Created date:            2010/08/15
** Version:                 V1
** Place                    qufu normal university
** Description: (ROWS) X must change from 1 to 4 and (Series)Y change from 1 to 16
void lcdWriteStr(char X,char Y,char *string)  //注意char 是字符型的 the "temp" in this funtion
means : line1 00--0F   line2: 10--1F  line3 : 20--2F     line4: 30--3F
*********************************************************************************************************/
#include "lcd12864.h"
//  ZLG的LOGO数据表  0--off    1--on 
unsigned char poweronpicture[1024] = {
	0x00,0x00,0x00,0x00,0x00,0x00,0x00,0x00,0x00,0x00,0x00,0x00,0x00,0x00,0x00,0x00,
	0x00,0x00,0x00,0x00,0x00,0x00,0x00,0x00,0x00,0x00,0x00,0x00,0x00,0x00,0x00,0x00,
	0x00,0x00,0x00,0x00,0x00,0x00,0x00,0x00,0x00,0x00,0x00,0x00,0x00,0x00,0x00,0x00,
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	0x00,0x00,0x00,0x00,0x00,0x00,0x00,0x00,0x00,0x00,0x00,0x00,0x00,0x00,0x00,0x00};
//lcd128*64 init
void lcdInit(void)
{
  SysCtlPeriEnable(LCD_PERIPH);  //enable GPIOB port 
  SysCtlPeriEnable(E_PERIPH);  //enable GPIOB port 
  GPIOPinTypeOut(E_PORT,LCD_CS);   //Set the corresponding pin as an output
  GPIOPinTypeOut(LCD_PORT,LCD_CLK);
  GPIOPinTypeOut(LCD_PORT,LCD_DIO);
  GPIOPinTypeOut(LCD_PORT,LCD_RST);
  GPIOPinTypeOut(LCD_PORT,LCD_PSB);
  GPIOPinWrite(LCD_PORT,LCD_RST,0xff);// disable RST
  GPIOPinWrite(LCD_PORT,LCD_PSB,0x00);//serial mode
  lcdComdWrite(0x30);               //   Feature set, the basic instructions 
  lcdComdWrite(0x30);               //   the basic instruction,8-bit model,the basic instruction
  lcdComdWrite(0x0c);               //Show open, cursor off, anti-white off
  lcdComdWrite(0x01);               //clear show
  lcdComdWrite(0x06);               //go into the set point，the curser shift to the right，the picture does not move
  
}
//clear all 
void clearAll(void)
{
  lcdComdWrite(0x01);
}
//write command to the LCM
void lcdComdWrite(unsigned int command)
{
  GPIOPinWrite(E_PORT,LCD_CS,0xff);
  lcdByteWrite(0xf8);
  lcdByteWrite(command&0xf0);        //write high 4-bits 
  command<<=4;
  lcdByteWrite(command&0xf0);       //write low 4-bits
}
//write data to the lcm
void lcdDataWrite(unsigned int data)  //write one byte
{
  GPIOPinWrite(E_PORT,LCD_CS,0xff);
  lcdByteWrite(0xfa);
  lcdByteWrite(data&0xf0);
  data<<=4;
  lcdByteWrite(data&0xf0);
}
//write a byte to the lcm
void lcdByteWrite(unsigned int bytename)  //how to write one byte to the lcm
{
  unsigned int i,dat;
  for(i=0;i<8;i++)
  {
    GPIOPinWrite(LCD_PORT,LCD_CLK,0x00);
    SysCtlDelay(5*(TheSysClock/3000000));
    dat=bytename&0x80;
    if(dat)
    {
      GPIOPinWrite(LCD_PORT,LCD_DIO,0xff);  //write 1
    }
    else
    {
      GPIOPinWrite(LCD_PORT,LCD_DIO,0x00);  //write 0
    }
    bytename<<=1;
    GPIOPinWrite(LCD_PORT,LCD_CLK,0xff);
    SysCtlDelay(5*(TheSysClock/3000000));
  }
}
//set X, y position to display
void lcdSetPos(char X,char Y)  //X--row 1--4   Y-collum 1--16
{
  unsigned char sendchar;
  switch(X)
  {
  case 1: sendchar=0x80+Y-1; break;   //设定DDRAM位址到地址寄存器AC
  case 2: sendchar=0x90+Y-1; break;
  case 3: sendchar=0x88+Y-1; break;
  case 4: sendchar=0x98+Y-1; break;
  default : sendchar=0x80+Y-1;
  break;
  }
  lcdComdWrite(sendchar);
}
                                               //write string to the lcm this functon is very important: every Chinese character must execut the cycle two times
void lcdWriteStr(char X,char Y,char *string)   //note that "charcode" is char type 8-bits
{
     unsigned int count=0;	
     char temp=0x00;                            //It's best to give "temp count" initial value
     unsigned char charcode;
     lcdSetPos(X,Y);  
     switch(X)
     {
      case 1: temp=0x00+Y*2-2; break;          //temp line1 00--0Fh  line2 10--1Fh 
      case 2: temp=0x10+Y*2-2; break;
      case 3: temp=0x20+Y*2-2; break;
      case 4: temp=0x30+Y*2-2; break;
     }
      while(1)
      {
        charcode = *string++;
        if(charcode == '\0') break;
        if(charcode <=0x7e && charcode >= 0x20)     //ASCII 02--7Fh is character the othes are chinese characters
        {
           count++;                                 //used for decide whether the number of characters are odd or even if even write a space before Chinese characters
        }
        else if(count%2==0)
         {
           count=0;
         }
        else
        {
          lcdDataWrite(0x20);
          temp++;                        //After write a space，add the address，re-check whether it need to change line
          if(temp==0x10)
          {
            lcdComdWrite(0x90);          //the second line
          }
          else
            if(temp==0x20)
            {
              lcdComdWrite(0x88);
            }
          else if(temp==0x30)
          {
            lcdComdWrite(0x98);
          }
           count=0;
        } 
        lcdDataWrite(charcode);  //one time write one byte, a Chinese character need write two times   if(temp == 0x0F)
        if(temp==0x0F)
        {
            temp = 0x10;    //the second line
            lcdSetPos(2,1);
        }
        else if(temp==0x1F)
        {
           temp = 0x20;       //the third line
           lcdSetPos(3,1);    //the same as lcdComdWrite();
        }
         else if(temp==0x2F)
        {
           temp =0x30;         // the fourth line
           lcdSetPos(4,1);
        }
        else 
          temp++;
      }    
}
//  open display 
void lcdPictureOn(void)
{
    lcdComdWrite(0x34);                                    //  Expand instruction
    lcdComdWrite(0x36);                                     //graph enable
    lcdComdWrite(0x30);                                    //  Base instruction
}

//  关闭图片显示功能
void lcdPictureOff(void)
{
	lcdComdWrite(0x34);                                       //  Expand instruction
	lcdComdWrite(0x30);                                       //Base instruction
	lcdComdWrite(0x30);                                       //  write two times

}

void lcdGdramAddress(unsigned int  VerticalAddr,unsigned int  HorizontalAddr)
{
        VerticalAddr &= 0x1F;
        HorizontalAddr &= 0x0F;
	lcdComdWrite(0x34);                             //  Expand instruction G is 0 graph disable
	lcdComdWrite(VerticalAddr|0x80);
	lcdComdWrite(HorizontalAddr|0x80);
	lcdComdWrite(0x30);                                       //  Base instruction
}
//  上电初始化图形显示缓冲区数据， 显示LOGO图形128*64点阵
void lcdPowerOnPictureInitDisplay(void)       //the lcm was divided to two parts the botom part and the top part
{
    unsigned char i,j;
    unsigned char * p;

    p = poweronpicture;                        //p add 1 means add one byte 8bit 

        for(i=0;i<32;i++)                      //  写入图形数据时采用逐行扫描的方式,一行16个字节
        {
            lcdGdramAddress(i,0);              //i means rows  and j means collums

            for(j=0;j<16;j++)
            {
                lcdDataWrite(*p);
                p++;
            }
        }
   
        for(i=0;i<32;i++)
        {
            lcdGdramAddress(i,8);

            for(j=0;j<16;j++)
            {    
                lcdDataWrite(*p);
                p++;
            }
        }      
}
void display1(void)       //显示一串字符
{
  unsigned char a=0x10;
  unsigned char i=0;
  lcdComdWrite(0x80);
  for(i=0;i<16;i++)
  {
    lcdDataWrite(a);
    a++;
  }
}
void display2(void)    //写一行汉字，从baco开始
{
  unsigned char a=0xba;
  unsigned char b=0xc0;
  unsigned char i;
  lcdComdWrite(0x90);
  for(i=0;i<16;i++)
  {
    lcdDataWrite(a);
    lcdDataWrite(b);
    b++;
  }
}
void display3(void)     //采用数组的形式显示汉字.
{
  unsigned char str[]="天天有个好心情";
  unsigned int i;

  lcdComdWrite(0x88);
  for(i=0;i<14;i++)
  {
    lcdDataWrite(str[i]);
   
  }
}
